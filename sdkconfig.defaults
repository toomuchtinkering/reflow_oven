## tools/bringup/11_http_server/sdkconfig.defaults
```kconfig
CONFIG_ESP_WIFI_DYNAMIC_TX_BUFFER=y
CONFIG_ESP_WIFI_DYNAMIC_RX_BUFFER=y
CONFIG_LWIP_NETIF_LOOPBACK=y
```

## tools/bringup/12_ota_endpoint/sdkconfig.defaults
```kconfig
CONFIG_ESP_WIFI_DYNAMIC_TX_BUFFER=y
CONFIG_ESP_WIFI_DYNAMIC_RX_BUFFER=y
CONFIG_LWIP_NETIF_LOOPBACK=y
CONFIG_BOOTLOADER_APP_ROLLBACK_ENABLE=y
CONFIG_APP_ROLLBACK_ENABLE=y
CONFIG_HTTPD_MAX_REQ_HDR_LEN=1024
```

## tools/bringup/13_self_tests/sdkconfig.defaults
```kconfig
CONFIG_LV_FONT_MONTSERRAT_20=y
CONFIG_LV_FONT_MONTSERRAT_28=y
CONFIG_LV_FONT_MONTSERRAT_48=y
```
